## conf/layer.conf
```bitbake
# Board specific layer configuration for meta-mender
# Copyright 2017 National Instruments Corp

# We have a conf and classes directory, add to BBPATH
BBPATH .= ":${LAYERDIR}"

# We have recipes-* directories, add to BBFILES
BBFILES += "${LAYERDIR}/recipes-*/*/*.bb \
	${LAYERDIR}/recipes-*/*/*.bbappend"

BBFILE_COLLECTIONS += "mender-usrp"
BBFILE_PATTERN_mender-usrp = "^${LAYERDIR}/"
BBFILE_PRIORITY_mender-usrp = "9"
```
